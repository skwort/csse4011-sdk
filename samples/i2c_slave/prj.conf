## CMakeLists.txt
```
# SPDX-License-Identifier: Apache-2.0

cmake_minimum_required(VERSION 3.20.0)
find_package(Zephyr REQUIRED HINTS $ENV{ZEPHYR_BASE})
project(i2c_slave)

target_sources(app PRIVATE src/main.c src/i2c_slave.c)
```

## sample.yaml
```
sample:
  name: I2C Slave Sample
tests:
  sample.i2c_slave:
    platform_allow: native_sim
    timeout: 5
```

## prj.conf
```kconfig
# Sample config
CONFIG_GPIO=y
CONFIG_I2C=y
CONFIG_I2C_TARGET=y
CONFIG_TEST_RANDOM_GENERATOR=y

CONFIG_LOG=y

# Native Sim
CONFIG_EMUL=y
CONFIG_I2C_EMUL=y
```

## boards/native_sim.overlay
```dts
/ {
	i2c1: i2c@400 {
		status = "okay";
		compatible = "zephyr,i2c-emul-controller";
		clock-frequency = <I2C_BITRATE_STANDARD>;
		#address-cells = <1>;
		#size-cells = <0>;
		#forward-cells = <1>;
		reg = <0x400 4>;
	};
};

&i2c0 {
	forwards = <&i2c1 0x20>;
};
```

## src/main.c
```c
/*
 * Copyright (c) 2025 Sam Kwort
 *
 * SPDX-License-Identifier: Apache-2.0
 */

#include <zephyr/kernel.h>
#include <zephyr/logging/log.h>
#include <zephyr/drivers/i2c.h>
#include <zephyr/devicetree.h>

#include "i2c_slave.h"

LOG_MODULE_REGISTER(main, LOG_LEVEL_INF);

#define SLEEP_TIME_MS 1000

#define I2C_CONTROLLER_NODE DT_NODELABEL(i2c0)

static const struct device *i2c_dev = DEVICE_DT_GET(I2C_CONTROLLER_NODE);

// Helper to write a single register
static int i2c_write_reg(uint8_t reg, uint8_t val)
{
    uint8_t buf[2] = {reg, val};
    return i2c_write(i2c_dev, buf, sizeof(buf), I2C_SLAVE_ADDR);
}

// Helper to read a single register
static int i2c_read_reg(uint8_t reg, uint8_t *val)
{
    int ret = i2c_write(i2c_dev, &reg, 1, I2C_SLAVE_ADDR);
    if (ret) {
        return ret;
    }
    return i2c_read(i2c_dev, val, 1, I2C_SLAVE_ADDR);
}

// Helper to read two bytes and combine into uint16_t
static int i2c_read_u16(uint8_t reg, uint16_t *out)
{
    uint8_t buf[2];
    int ret = i2c_write(i2c_dev, &reg, 1, I2C_SLAVE_ADDR);
    if (ret) {
        return ret;
    }
    ret = i2c_read(i2c_dev, buf, sizeof(buf), I2C_SLAVE_ADDR);
    if (ret) {
        return ret;
    }
    *out = ((uint16_t)buf[1] << 8) | buf[0];
    return 0;
}

int main(void)
{
    if (!device_is_ready(i2c_dev)) {
        LOG_ERR("I2C device not ready");
        return 1;
    }

    // Let the slave start
    k_sleep(K_MSEC(100));

    uint8_t val;
    uint16_t temp, humid;
    int ret;

    // 1. Read WHO_AM_I
    ret = i2c_read_reg(REG_WHO_AM_I, &val);
    if (ret) {
        LOG_ERR("WHO_AM_I read failed: %d", ret);
        return 1;
    }
    LOG_INF("WHO_AM_I = 0x%02X", val);

    // 2. Attempt to start measurement while locked
    LOG_INF("Trying measurement while locked...");
    ret = i2c_write_reg(REG_CTRL1, 0x01);
    if (ret) {
        LOG_ERR("Write failed: %d", ret);
    }

    // 3. Read session code and unlock
    uint8_t session_code;
    i2c_read_reg(REG_SESSION_CODE, &session_code);
    LOG_INF("Session code: 0x%02X", session_code);

    LOG_INF("Unlocking device...");
    i2c_write_reg(REG_UNLOCK, session_code);

    // 4. Start measurement
    LOG_INF("Starting measurement...");
    i2c_write_reg(REG_CTRL1, 0x01);

    // 5. Poll until data ready
    while (1) {
        i2c_read_reg(REG_STATUS, &val);
        if (val & STATUS_DATA_READY) {
            break;
        }
        k_msleep(100);
    }
    LOG_INF("Data ready!");

    // 6. Read temp/humid
    i2c_read_u16(REG_TEMP_L, &temp);
    i2c_read_u16(REG_HUMID_H, &humid);
    LOG_INF("Temperature: %u (x0.01 °C)", temp);
    LOG_INF("Humidity: %u (x0.01 %%)", humid);

    // 7. Wait for auto-lock
    LOG_INF("Waiting for auto-lock...");
    while (1) {
        i2c_read_reg(REG_LOCK_STATUS, &val);
        if (val == LOCKED) {
            LOG_INF("Device locked again.");
            break;
        }
        k_msleep(500);
    }

    return 0;
}
```

## src/i2c_slave.c
```c
/*
 * Copyright (c) 2025 Sam Kwort
 *
 * SPDX-License-Identifier: Apache-2.0
 */

#include <zephyr/kernel.h>
#include <zephyr/logging/log.h>
#include <zephyr/drivers/gpio.h>
#include <zephyr/drivers/i2c.h>
#include <zephyr/random/random.h>
#include <zephyr/devicetree.h>

#include "i2c_slave.h"

LOG_MODULE_REGISTER(i2c_slave, LOG_LEVEL_INF);

#define I2C_TARGET_NODE DT_NODELABEL(i2c1)
#define I2C_TARGET_ADDR 0x20

#define MEASUREMENT_DELAY_MS 500
#define LOCK_TIMEOUT_MS      5000 // 5 seconds before locking again

const struct device *i2c_target_dev = DEVICE_DT_GET(I2C_TARGET_NODE);

// Mutex to protect registers
K_MUTEX_DEFINE(register_mutex);
#define LOCK_REGISTERS(timeout)   k_mutex_lock(&register_mutex, timeout)
#define UNLOCK_REGISTERS(timeout) k_mutex_unlock(&register_mutex)

// Fake hardware register contents
static uint8_t registers[REG_COUNT] = {
    0x42,          // WHO_AM_I
    0x00,          // CTRL1
    STATUS_LOCKED, // STATUS: locked, no data-ready
    0xFF,          // TEMP_L (locked => FF)
    0xFF,          // TEMP_H
    0xFF,          // HUMID_L
    0xFF,          // HUMID_H
    0x00,          // CONFIG
    0x00,          // padding
    0x00,          // SESSION_CODE (filled at init)
    0x00,          // UNLOCK
    LOCKED         // LOCK_STATUS (locked)
};

// Read-only register mask
static bool reg_readonly[REG_COUNT] = {
    true,  // WHO_AM_I
    false, // CTRL1
    true,  // STATUS
    true,  // TEMP_L
    true,  // TEMP_H
    true,  // HUMID_L
    true,  // HUMID_H
    false, // CONFIG
    false, // padding
    true,  // SESSION_CODE
    false, // UNLOCK
    true   // LOCK_STATUS
};

// Internal state
static uint8_t current_reg;
static bool reg_addr_received;

// Measurement state
static bool measurement_in_progress;
static int64_t measurement_start_time_ms;

// Unlock timeout tracking
static int64_t unlock_time_ms;

// Forward declarations
static void start_measurement(void);
static void complete_measurement(void);
static void lock_device(void);
static void unlock_device(void);

// Locking helper
static void lock_device(void)
{
    LOCK_REGISTERS(K_FOREVER);

    registers[REG_LOCK_STATUS] = LOCKED;

    // Mark status as locked
    registers[REG_STATUS] |= STATUS_LOCKED;

    // Clear data-ready bit
    registers[REG_STATUS] &= ~STATUS_DATA_READY;

    // Clear TEMP/HUMID when locked
    registers[REG_TEMP_L] = 0xFF;
    registers[REG_TEMP_H] = 0xFF;
    registers[REG_HUMID_L] = 0xFF;
    registers[REG_HUMID_H] = 0xFF;
    measurement_in_progress = false;
    LOG_INF("Device locked");

    UNLOCK_REGISTERS();
}

static void unlock_device(void)
{
    LOCK_REGISTERS(K_FOREVER);

    registers[REG_LOCK_STATUS] = UNLOCKED;

    // Clear locked flag in STATUS
    registers[REG_STATUS] &= ~STATUS_LOCKED;

    unlock_time_ms = k_uptime_get();
    LOG_INF("Device unlocked");

    UNLOCK_REGISTERS();
}

// Periodic lock timeout check
static void lock_timeout_handler(struct k_timer *timer)
{
    ARG_UNUSED(timer);
    if (registers[REG_LOCK_STATUS] == UNLOCKED) {
        if ((k_uptime_get() - unlock_time_ms) > LOCK_TIMEOUT_MS) {
            lock_device();
        }
    }
}

K_TIMER_DEFINE(lock_timer, lock_timeout_handler, NULL);

// start_measurement: kick off a measurement (non-blocking)
static void start_measurement(void)
{
    if (registers[REG_LOCK_STATUS] == LOCKED) {
        LOG_WRN("Attempted measurement while locked");
        return;
    }
    if (measurement_in_progress) {
        LOG_WRN("Measurement already in progress");
        return;
    }
    measurement_in_progress = true;
    measurement_start_time_ms = k_uptime_get();

    // clear data ready bit
    registers[REG_STATUS] &= ~STATUS_DATA_READY;
    LOG_INF("Measurement started");
}

// complete_measurement: finish measurement, write temp/humid, set data-ready
static void complete_measurement(void)
{
    // Generate fake temperature/humidity
    uint16_t temp = 2000 + (sys_rand32_get() % 1000);  // 20.00°C base
    uint16_t humid = 5000 + (sys_rand32_get() % 2000); // 50.00% base

    LOCK_REGISTERS(K_FOREVER);

    registers[REG_TEMP_L] = (uint8_t)(temp & 0xFF);
    registers[REG_TEMP_H] = (uint8_t)((temp >> 8) & 0xFF);
    registers[REG_HUMID_L] = (uint8_t)(humid & 0xFF);
    registers[REG_HUMID_H] = (uint8_t)((humid >> 8) & 0xFF);

    registers[REG_STATUS] |= STATUS_DATA_READY;

    UNLOCK_REGISTERS();

    measurement_in_progress = false;
    LOG_INF("Measurement complete: temp=%u (x0.01), humid=%u (x0.01)", temp,
            humid);
}

// I2C Callbacks

// Callback: master starts a write
static int target_write_requested(struct i2c_target_config *target_config)
{
    LOG_INF("Write requested");
    reg_addr_received = false;
    return 0;
}

// Callback: master sends data byte
static int target_write_received(struct i2c_target_config *target_config,
                                 uint8_t val)
{
    if (!reg_addr_received) {
        // First byte is register address
        current_reg = val % REG_COUNT;
        reg_addr_received = true;
        LOG_INF("Register address set to 0x%02X", current_reg);
    } else {
        LOG_INF("Want to write to: 0x%02X", current_reg);
        // Subsequent bytes are data
        if (reg_readonly[current_reg]) {
            LOG_WRN("Write attempt to read-only reg 0x%02X", current_reg);
        } else {
            LOG_INF("Write reg[0x%02X] = 0x%02X", current_reg, val);
            registers[current_reg] = val;

            // Special: CTRL1 start measurement (bit0)
            if (current_reg == REG_CTRL1 && (val & 0x01)) {
                start_measurement();
            }

            // Special: unlock logic
            if (current_reg == REG_UNLOCK) {
                if (val == registers[REG_SESSION_CODE]) {
                    unlock_device();
                } else {
                    LOG_WRN("Incorrect unlock code: 0x%02X", val);
                }
            }
        }
        current_reg = (current_reg + 1) % REG_COUNT; // Auto-increment
    }
    return 0;
}

// Callback: master starts a read
static int target_read_requested(struct i2c_target_config *target_config,
                                 uint8_t *val)
{
    *val = registers[current_reg];
    LOG_INF("Read reg[0x%02X] = 0x%02X", current_reg, *val);
    return 0;
}

// Callback: master reads more data
static int target_read_processed(struct i2c_target_config *target_config,
                                 uint8_t *val)
{
    current_reg = (current_reg + 1) % REG_COUNT;
    *val = registers[current_reg];
    LOG_INF("Read reg[0x%02X] = 0x%02X", current_reg, *val);
    return 0;
}

// Callback: stop condition
static int target_stop(struct i2c_target_config *config)
{
    LOG_INF("Stop condition");
    return 0;
}

static const struct i2c_target_callbacks target_callbacks = {
    .write_requested = target_write_requested,
    .read_requested = target_read_requested,
    .write_received = target_write_received,
    .read_processed = target_read_processed,
    .stop = target_stop,
};

static struct i2c_target_config target_config = {
    .address = I2C_TARGET_ADDR,
    .callbacks = &target_callbacks,
};

static int i2c_slave_init(void)
{
    // Generate random session code
    uint8_t code = (uint8_t)(sys_rand32_get() & 0xFF);
    registers[REG_SESSION_CODE] = code;

    // STATUS initial: locked
    registers[REG_STATUS] = STATUS_LOCKED;
    registers[REG_LOCK_STATUS] = LOCKED;

    int ret = i2c_target_register(i2c_target_dev, &target_config);
    if (ret) {
        LOG_ERR("Failed to register i2c target: %d", ret);
        return ret;
    }

    // Start lock timeout timer (tick every 1s)
    k_timer_start(&lock_timer, K_MSEC(1000), K_MSEC(1000));
    return 0;
}

int i2c_slave_main(void)
{
    i2c_slave_init();

    while (1) {
        uint32_t now = k_uptime_get();
        if (measurement_in_progress &&
            (now - measurement_start_time_ms) >= MEASUREMENT_DELAY_MS) {
            complete_measurement();
        }
        k_msleep(50);
    }
}

#define I2C_SLAVE_THREAD_STACKSIZE 1024
#define I2C_SLAVE_THREAD_PRIORITY  6

K_THREAD_DEFINE(i2c_slave_thread, I2C_SLAVE_THREAD_STACKSIZE, i2c_slave_main,
                NULL, NULL, NULL, I2C_SLAVE_THREAD_PRIORITY, 0, 0);
```

## src/i2c_slave.h
```c
/*
 * Copyright (c) 2025 Sam Kwort
 *
 * SPDX-License-Identifier: Apache-2.0
 */

#ifndef _I2C_SLAVE_H_
#define _I2C_SLAVE_H_

#define I2C_SLAVE_ADDR 0x20

// Register addresses
enum {
    REG_WHO_AM_I = 0x00,
    REG_CTRL1 = 0x01,
    REG_STATUS = 0x02,
    REG_TEMP_L = 0x03,
    REG_TEMP_H = 0x04,
    REG_HUMID_H = 0x05,
    REG_HUMID_L = 0x06,
    REG_CONFIG = 0x07,
    REG_PADDING = 0x08,
    REG_SESSION_CODE = 0x09,
    REG_UNLOCK = 0x0A,
    REG_LOCK_STATUS = 0x0B,
    REG_COUNT = 0x0C
};

// STATUS bits
#define STATUS_DATA_READY (1 << 0)
#define STATUS_LOCKED     (1 << 1)

// LOCK_STATUS values
#define LOCKED   0x01
#define UNLOCKED 0x00

#endif // _I2C_SLAVE_H_
```
