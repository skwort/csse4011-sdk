## Kconfig
```kconfig
# CSSE4011 SDK configuration

menuconfig CSSE4011
	bool "CSSE4011 SDK"
	help
	  Enable CSSE4011 SDK features.

if CSSE4011

rsource "lib/kite/Kconfig"

endif # CSSE4011
```

## lib/kite/Kconfig
```kconfig
# CSSE4011 Kite Shell configuration

menuconfig CSSE4011_SHELL
	bool "CSSE4011 Kite Shell Commands"
	depends on SHELL
	help
	  Enable the 'kite' shell command set for the XIAO BLE board.
	  Provides board-specific commands for peripherals including
	  GPIO, ADC, I2C, UART, LED, and PWM.

if CSSE4011_SHELL

rsource "led/Kconfig"
rsource "gpio/Kconfig"
rsource "pwm/Kconfig"
rsource "uart/Kconfig"
rsource "i2c/Kconfig"
rsource "adc/Kconfig"
rsource "imu/Kconfig"
rsource "ble/Kconfig"

endif # CSSE4011_SHELL
```

## lib/kite/adc/Kconfig
```kconfig
config CSSE4011_SHELL_ADC
	bool "Kite ADC commands"
	default y
	select ADC
	help
	  Enable kite adc subcommands for reading analog inputs
	  on the XIAO connector pins D0-D5 via the nRF SAADC.
```

## lib/kite/ble/Kconfig
```kconfig
config CSSE4011_SHELL_BLE
	bool "Kite BLE commands"
	default y
	depends on BT
	depends on BT_BROADCASTER
	help
	  Enable kite ble subcommands for non-connectable
	  BLE beacon advertising with configurable device
	  name and manufacturer data.
```

## lib/kite/gpio/Kconfig
```kconfig
config CSSE4011_SHELL_GPIO
	bool "Kite GPIO commands"
	default y
	select GPIO
	select GPIO_GET_DIRECTION
	help
	  Enable kite gpio subcommands for controlling the XIAO
	  connector pins D0-D10.
```

## lib/kite/i2c/Kconfig
```kconfig
config CSSE4011_SHELL_I2C
	bool "Kite I2C commands"
	default y
	select I2C
	help
	  Enable kite i2c subcommands for scanning and communicating
	  with I2C devices on the XIAO connector (D4=SDA, D5=SCL).
```

## lib/kite/imu/Kconfig
```kconfig
config CSSE4011_SHELL_IMU
	bool "Kite IMU commands"
	default y
	select SENSOR
	select LSM6DSL
	help
	  Enable kite imu subcommands for reading the onboard
	  LSM6DS3TR-C accelerometer and gyroscope.
```

## lib/kite/led/Kconfig
```kconfig
config CSSE4011_SHELL_LED
	bool "Kite LED commands"
	default y
	select GPIO
	help
	  Enable kite led subcommands for controlling the onboard
	  RGB LED on the XIAO BLE board.
```

## lib/kite/pwm/Kconfig
```kconfig
config CSSE4011_SHELL_PWM
	bool "Kite PWM commands"
	default y
	select PWM
	help
	  Enable kite pwm subcommands for PWM output control,
	  including RGB LED brightness via PWM.
```

## lib/kite/uart/Kconfig
```kconfig
config CSSE4011_SHELL_UART
	bool "Kite UART commands"
	default y
	select SERIAL

if CSSE4011_SHELL_UART

choice CSSE4011_SHELL_UART_API
	prompt "UART shell API mode"
	default CSSE4011_SHELL_UART_IRQ

config CSSE4011_SHELL_UART_IRQ
	bool "Interrupt-driven API"
	select UART_INTERRUPT_DRIVEN

config CSSE4011_SHELL_UART_ASYNC
	bool "Async/DMA API"
	depends on SERIAL_SUPPORT_ASYNC
	select UART_ASYNC_API

endchoice

endif # CSSE4011_SHELL_UART
```

## west.yml
```yaml
# The west manifest file (west.yml) for CSSE4011
#
# This manifest file was based loosely on the Nordic Connect SDK configuration
# file in [1].
#
# For more details on the west and this manifest file refer to [2].
#
# [1]:https://github.com/nrfconnect/sdk-nrf/blob/main/west.yml
# [2]:https://docs.zephyrproject.org/latest/develop/west/index.html
manifest:
  # "remotes" is a list of locations where git repositories are cloned
  # and fetched from.
  remotes:
    # UQ Embedded Systems GitHub organisation where our code is hosted
    - name: uqembeddedsys
      url-base: https://github.com/skwort
    # Third-party repository sources:
    - name: zephyrproject
      url-base: https://github.com/zephyrproject-rtos

  # set the default remote to uqembeddedsys
  defaults:
    remote: uqembeddedsys

  # "projects" is a list of git repositories which make up the SDK
  projects:
    - name: zephyr
      remote: zephyrproject      
      repo-path: zephyr
      revision: v4.2.0
      clone-depth: 1
      import:
        # In addition to the zephyr repository itself, we also
        # imports the contents of zephyr/west.yml at the above
        # revision. Only the projects explicitly named in the
        # following allowlist are imported.
        #
        # Note that the zephyr west extensions (like 'build', 'flash',
        # 'debug', etc.) are automatically provided by this import, so
        # there's no need to add a redundant west-commands: key for
        # the zephyr project.
        #
        # Please keep this list sorted alphabetically.
        name-allowlist:
          - canopennode
          - chre
          - cmsis
          - cmsis-dsp
          - cmsis-nn
          - cmsis_6
          - edtt
          - fatfs
          - hal_nordic
          - hal_st # required for ST sensors (unrelated to STM32 MCUs)
          - hal_tdk # required for Invensense sensors such as ICM42670
          - hal_wurthelektronik
          - hostap
          - liblc3
          - libmetal
          - littlefs
          - loramac-node
          - lvgl
          - lz4
          - mipi-sys-t
          - nanopb
          - net-tools
          - nrf_hw_models
          - nrf_wifi
          - open-amp
          - percepio
          - picolibc
          - segger
          - tf-m-tests
          - tinycrypt
          - uoscore-uedhoc
          - zcbor
          - zscilib

  # West-related configuration for the the SDK.
  self:
    # This repository should be cloned to app_root/csse4011-sdk.
    path: csse4011-sdk 
```
